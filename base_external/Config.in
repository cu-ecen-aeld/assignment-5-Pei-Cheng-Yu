## base_external/package/Config.in
```kconfig
menu "AESD custom packages"
    source "package/aesd-assignments/Config.in"
endmenu
```

## base_external/package/aesd-assignments/Config.in
```kconfig
config BR2_PACKAGE_AESD_ASSIGNMENTS
    bool "aesd-assignments"
    help
      Clones and builds code from the assignment-3-and-later repository.
```
